## components/eink/Kconfig.projbuild
```kconfig
menu "E-ink display"

    # The panel choice is NOT here. It is a plain #define in
    # components/eink/include/eink_panel.h - one line, no menuconfig.

    config EINK_SPI_CLOCK_HZ
        int "SPI clock (Hz)"
        default 10000000
        range 1000000 20000000
        help
            10 MHz is what both vendor drivers use. Lower it if the FPC run to
            CON1 turns out to be marginal.

    config EINK_FULL_REFRESH_INTERVAL
        int "Partial refreshes between full refreshes"
        default 12
        range 0 100
        help
            Partial refreshes are fast and quiet but leave ghosting behind. A
            full refresh clears it and costs a visible flash plus several
            seconds. 0 forces every refresh to be a full one. Ignored on the
            four-colour panel, which has no partial mode.

    config JD79660_FAST_MODE
        bool "Four-colour panel: use the fast refresh waveform"
        default y
        help
            Cuts a full four-colour refresh from roughly 30 s to roughly 21 s,
            at the cost of the low end of the panel temperature range. Turn it
            off for a unit that has to update while it is near freezing.

endmenu
```

## main/Kconfig.projbuild
```kconfig
menu "Soil Sensor Configuration"

    orsource "$IDF_PATH/examples/common_components/env_caps/$IDF_TARGET/Kconfig.env_caps"

    config SOILSENSOR_STATUS_LED_GPIO
        int "Status LED GPIO number"
        range ENV_GPIO_RANGE_MIN ENV_GPIO_OUT_RANGE_MAX
        default 8
        help
            GPIO the addressable status LED (WS2812) of the sensor board is
            connected to.

    config SOILSENSOR_STATUS_LED_BRIGHTNESS
        int "Status LED brightness (0-255 per color channel)"
        range 0 255
        default 16
        help
            Value written to each RGB channel when the status LED is on.
            The LED is bright, low values are plenty.

    config SOILSENSOR_HEARTBEAT_PERIOD_MS
        int "Status LED heartbeat period in ms"
        range 10 3600000
        default 1000
        help
            Toggle period of the status LED heartbeat.

endmenu
```
